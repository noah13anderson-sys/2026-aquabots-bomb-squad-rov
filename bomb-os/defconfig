## bomb-os/defconfig
```kconfig
# BR2_TARGET_GENERIC_GETTY is not set
BR2_PACKAGE_LVGL=y
BR2_PACKAGE_LIBDRM=y
BR2_LINUX_KERNEL_CONFIG_FRAGMENT_FILES="../bomb-os/linux.fragment"
BR2_PACKAGE_LIBEVDEV=y
BR2_PACKAGE_BLUEZ5_UTILS=y
BR2_PACKAGE_BLUEZ5_UTILS_CLIENT=y
```
